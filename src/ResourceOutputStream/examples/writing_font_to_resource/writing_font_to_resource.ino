#include <Wire.h>
#include <ExternalEeprom.h>
#include <External24cl256Eeprom.h>
#include <rs.h>
#include <rs_util.h>
#include <rs_io.h>
#include <rs_init_partition.h>
#include <Resource.h>
#include <ResourceIO.h>
#include <ResourceSystem.h>
#include <SimpleResource.h>
#include <SimpleResourceIO.h>
#include <SimpleResourceSystem.h>
#include <SimpleExternalEepromResourceIO.h>
#include <Closeable.h>
#include <OutputStream.h>
#include <ResourceOutputStream.h>

rs_global_flags_t rs_global_flags;
SimpleResourceIO* SimpleResourceIO::association[RESOURCE_IO_DRIVERS_NUM];

const unsigned char font[] = {
	0x00,0x05,0x08,0x02, // Header
	0x20,0x50,0x00,0x0c, // Seg 0
	0x51,0x7d,0x01,0x01, // Seg 1
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	0x00,0x00,0x7f,0x00,0x00,0x00,0x41,0x36,0x08,0x00   // |}
};

void setup() {
  Serial.begin(9600);
  
  SimpleResourceSystem resourceSystem(RS_DRIVER_ARDUINO_EEPROM);
  External24cl256Eeprom eeprom(0x04);
  SimpleExternalEepromResourceIO io(&eeprom);
  SimpleResourceIO::associateIO(&io, RS_DRIVER_ARDUINO_EEPROM);

  Serial.print("Started at: ");
  Serial.println(millis());

  Serial.print("Monting... ");
  if (resourceSystem.mount(ResourceSystem::MOUNT_READ_WRITE)) {
    Serial.println("done.");
  } else {
    Serial.print("fail. Last operation result: ");
    Serial.println((int)resourceSystem.getLastOperationResult());
    return;
  }
  
  SimpleResource sr = resourceSystem.getResourceByCode(0);

  Serial.print("Resource code: ");
  Serial.println(sr.getCode());

  if (!sr.open(Resource::OPEN_READ_WRITE)) {
    Serial.print("Cannot open resource. Error: ");
    Serial.println((int)sr.getLastOperationResult());
    return;
  }

  Serial.print("Resource size before: ");
  Serial.println(sr.size());

  if (!sr.truncate()) {
    Serial.print("Cannot truncate resource. Error: ");
    Serial.println((int)sr.getLastOperationResult());
    return;
  }

  ResourceOutputStream ros(&sr);
  
  Serial.print("Font size: ");
  Serial.println(sizeof(font));
  
  Serial.print("Writing");
  for (unsigned int i = 0; i < sizeof(font); i++) {
    ros.write(font[i]);
    Serial.print(sr.getLastOperationResult());
  }
  Serial.println("done.");

  Serial.print("Resource size after: ");
  Serial.println(sr.size());

  ros.close();

  Serial.print("Umonting... ");
  if (resourceSystem.umount()) {
    Serial.println("done.");
  } else {
    Serial.print("fail. Last operation result: ");
    Serial.println((int)resourceSystem.getLastOperationResult());
    return;
  }

  Serial.print("Finished at: ");
  Serial.println(millis());
}

void loop() {
}

